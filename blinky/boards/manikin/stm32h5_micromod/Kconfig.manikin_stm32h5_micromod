## blinky/boards/manikin/stm32h5_micromod/Kconfig.manikin_stm32h5_micromod
```kconfig
# Copyright (c) 2025 Kacper Brzostowski
# SPDX-License-Identifier: Apache-2.0

config BOARD_MANIKIN_STM32H5_MICROMOD
	select SOC_STM32H562XX
```

## blinky/boards/manikin/stm32h5_micromod/board.yml
```yaml
board:
  name: manikin_stm32h5_micromod
  full_name: manikin STM32H5 micromod
  vendor: manikin
  socs:
    - name: stm32h562xx
```

## blinky/boards/weact/stm32h5_cor/Kconfig.weact_stm32h5_cor
```kconfig
# Copyright (c) 2025 Kacper Brzostowski
# SPDX-License-Identifier: Apache-2.0

config BOARD_WEACT_STM32H5_COR
	select SOC_STM32H562XX
```

## blinky/boards/weact/stm32h5_cor/board.yml
```yaml
board:
  name: weact_stm32h5_cor
  full_name: STM32H5 Cor Board
  vendor: weact
  socs:
    - name: stm32h562xx
```
